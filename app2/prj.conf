## CMakeLists.txt
```
cmake_minimum_required(VERSION 3.20.0)
find_package(Zephyr REQUIRED HINTS $ENV{ZEPHYR_BASE})

project(app2 LANGUAGES C)

target_sources(app2 PRIVATE src/main.c)
```

## prj.conf
```kconfig
# This file contains selected Kconfig options for the application.

# Nothing here.
```

## src/main.c
```c
#include <app_version.h>
#include <zephyr/kernel.h>

int main(void) {
    printk("Application version app2 %s initialized on board %s!\r\n",
           APP_VERSION_STRING, CONFIG_BOARD);
    return 0;
}
```
